## config/boards/shields/Lele69/Kconfig.defconfig
```kconfig
if SHIELD_LELE69

config ZMK_KEYBOARD_NAME
    default "TARS"

config ZMK_SLEEP
	default n
endif


CONFIG_ZMK_RGB_UNDERGLOW=y
# Use the STRIP config specific to the LEDs you're using
CONFIG_WS2812_STRIP=y

if ZMK_DISPLAY
config I2C
    default y
config SSD1306
    default y

config SSD1306_REVERSE_MODE
    default y

endif # ZMK_DISPLAY

if LVGL

config LV_Z_HOR_RES_MAX
    default 128
config LV_Z_VER_RES_MAX
    default 32
config LV_Z_VDB_SIZE
    default 64

config LV_DPI_DEF
    default 148
config LV_Z_BITS_PER_PIXEL
    default 1
choice LV_COLOR_DEPTH
    default LV_COLOR_DEPTH_1
endchoice

endif # LVGL

config ZMK_WIDGET_WPM_STATUS
	default y
```
